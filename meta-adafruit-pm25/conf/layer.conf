## meta-adafruit-pm25/conf/layer.conf
```bitbake
# We have a conf and classes directory, add to BBPATH
BBPATH .= ":${LAYERDIR}"

# We have recipes-* directories, add to BBFILES
BBFILES += "${LAYERDIR}/recipes-*/*/*.bb \
            ${LAYERDIR}/recipes-*/*/*.bbappend"

BBFILE_COLLECTIONS += "meta-adafruit-pm25"
BBFILE_PATTERN_meta-adafruit-pm25 = "^${LAYERDIR}/"
BBFILE_PRIORITY_meta-adafruit-pm25 = "6"

LAYERDEPENDS_meta-adafruit-pm25 = "core"
LAYERSERIES_COMPAT_meta-adafruit-pm25 = "scarthgap"
```
